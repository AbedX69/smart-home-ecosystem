## firmware/testing/wireless/ble-test/sdkconfig.defaults
```kconfig
# =============================================================================
# NimBLE Configuration
# =============================================================================
# This file enables NimBLE as the BLE host stack instead of Bluedroid.
# NimBLE uses ~50% less RAM than Bluedroid for BLE-only applications.

CONFIG_BT_ENABLED=y
CONFIG_BT_NIMBLE_ENABLED=y
CONFIG_BT_NIMBLE_MAX_CONNECTIONS=3
CONFIG_BT_NIMBLE_MAX_BONDS=3
CONFIG_BT_NIMBLE_ROLE_CENTRAL=y
CONFIG_BT_NIMBLE_ROLE_PERIPHERAL=y
CONFIG_BT_NIMBLE_ROLE_OBSERVER=y
CONFIG_BT_NIMBLE_ROLE_BROADCASTER=y

# Security
CONFIG_BT_NIMBLE_SM_LEGACY=y
CONFIG_BT_NIMBLE_SM_SC=y

# Logging (reduce for production)
CONFIG_BT_NIMBLE_LOG_LEVEL=1
```

## firmware/wireless/testing/ota-test/sdkconfig.defaults
```kconfig
# =============================================================================
# OTA Configuration
# =============================================================================
# Enable rollback support so the bootloader can revert to previous firmware
# if the new one doesn't call esp_ota_mark_app_valid_cancel_rollback().

CONFIG_BOOTLOADER_APP_ROLLBACK_ENABLE=y
```

## firmware/wireless/testing/zigbee-test/sdkconfig.defaults
```kconfig
# Zigbee device role (change for coordinator/router)
# ZB_ED_ROLE   = End Device (light, sensor)
# ZB_ZCZR_ROLE = Coordinator or Router
CONFIG_ZB_ENABLED=y
CONFIG_ZB_ZED=y

# Partition table
CONFIG_PARTITION_TABLE_CUSTOM=y
CONFIG_PARTITION_TABLE_CUSTOM_FILENAME="partitions.csv"

# Recommended: disable idle task WDT for Zigbee (stack can be slow)
CONFIG_ESP_TASK_WDT_CHECK_IDLE_TASK_CPU0=n
```
